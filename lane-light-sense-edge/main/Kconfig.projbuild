## lane-light-sense-edge/main/Kconfig.projbuild
```kconfig
menu "User Configuration"

    config CONFIG_ESP_01_PORT
        int "UART Port Number"
        default 2
        help
            The port number for the UART used with the ESP-01 for bluetooth.
    
    config CONFIG_ESP_01_TX_PIN
        int "UART TX PIN"
        default 7
        help
            The pin number of the UART TX pin used with the ESP-01 for bluetooth.

    config CONFIG_ESP_01_RX_PIN
        int "UART RX PIN"
        default 6
        help
            The pin number of the UART RX pin used with the ESP-01 for bluetooth.

    config CONFIG_ESP_01_BAUD
        int "UART BAUD"
        default 115200
        help
            The baud rate used for the UART connection to the ESP-01 for bluetooth.

    config CONFIG_ESP_01_BUFFER_SIZE
        int "UART Buffer Size"
        default 1024
        help
            The buffer size for the UART connection to the ESP-01 for bluetooth in bytes.
    
    config CONFIG_LED_PIN
        int "LED Pin"
        default 7
        help
            The pin number for the led data.

    config CONFIG_LED_COUNT
        int "LED Count"
        default 20
        help
            The number of leds in the strip.

    config CONFIG_COAP_PORT
        int "COAP Port"
        default 5684
        help
            The port number of the COAP Server (to connect to).
    
    config CONFIG_COAP_SERVER_PORT
        string "COAP Server Address"
        default "192.168.0.1"
        help
            The ipv4 address of the target COAP server.
    
    config ESP_WIFI_SSID
        string "WiFi SSID"
        default "myssid"
        help
            SSID (network name) for the example to connect to.

    config ESP_WIFI_PASSWORD
        string "WiFi Password"
        default "mypassword"
        help
            WiFi password (WPA or WPA2) for the example to use.

endmenu
```
